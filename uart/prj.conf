## CMakeLists.txt
```
# SPDX-License-Identifier: Apache-2.0

cmake_minimum_required(VERSION 3.20.0)
find_package(Zephyr REQUIRED HINTS $ENV{ZEPHYR_BASE})
project(uart)

target_sources(app PRIVATE src/main.c src/keypad.c src/led.c)
```

## prj.conf
```kconfig
CONFIG_PRINTK=y
CONFIG_GPIO=y
CONFIG_LOG=y

# Enable the serial driver in asynchronous mode
CONFIG_SERIAL=y
CONFIG_UART_ASYNC_API=y

# Add configurations to enable timeslicing
CONFIG_TIMESLICING=y
CONFIG_TIMESLICE_SIZE=10
CONFIG_TIMESLICE_PRIORITY=0
```

## src/main.c
```c
#include "keypad.h"
#include "led.h"

// just for fun - using message queue to pass button presses 1-3
// from UART to led 1-3
// led 0 is used by a heartbeat thread in led

#define QUEUE_SIZE 16
#define DATA_LEN 1
#define DATA_ALIGN 1

extern void run_timer(void);

K_MSGQ_DEFINE(queue, DATA_LEN, QUEUE_SIZE, DATA_ALIGN);

keypad keyp;

// main thread
int main(void) {
    printk("main 1.0.6 starts\n");
    if (init()) {
        printk("init failed\n");
        return 1;
    }
    run_timer();
    // main loop
    while (1) {
        k_yield();
        work();
    }
}

int init() {
    if (keypad_init(&keyp)) {
        printk("keypad_init failed");
        return 1;
    }
    if (led_init()) {
        printk("led_init failed");
        return 1;
    }
    return 0;
}

void work() {
    uint8_t idx;
    //  Read all keypad codes from the queue
    while (k_msgq_num_used_get(&queue)) {
        k_msgq_get(&queue, &idx, K_NO_WAIT);
        idx = idx - 48;
        // we handle only 1,2,3
        if (idx > 0 && idx < 4) {
            led_toggle(idx);
        }
        k_yield();
        k_msleep(10);
    }
    k_msleep(20);
}
```

## src/keypad.c
```c
#include "keypad.h"

#include <string.h>
#include <zephyr/sys/printk.h>

extern struct k_msgq queue;

/*  callback function for UART */
static int keypad_received_event(const struct device *dev, struct uart_event *evt, void *keyp) {
    switch (evt->type) {
        case UART_RX_RDY:
            if ((evt->data.rx.len) == 1) {
                // received 1 char - send it to the queue
                uint8_t ch = evt->data.rx.buf[evt->data.rx.offset];
                if (k_msgq_put(&queue, &ch, K_NO_WAIT)) {
                    printk("k_msgq_put error\n");
                }
            }
            break;
        case UART_RX_DISABLED:
            // reenable
            uart_rx_enable(dev, ((keypad *)keyp)->rx_buf, RECEIVE_BUF_SIZE, RECEIVE_TIMEOUT);
            break;

        default:
            break;
    }
}

// keypad reads characters from the serial consoles
// it acts as producer and sends them to led consumer using message queue
int keypad_init(keypad *keypad) {
    keypad->uart = DEVICE_DT_GET(DT_NODELABEL(uart0));
    strncpy(keypad->tx_buf, "\nPress 1-3 on nRF terminal to toggle LEDS 1-3 on DK\n", SEND_BUF_SIZE);
    if (uart_callback_set(keypad->uart, keypad_received_event, keypad)) {
        return 1;
    }
    if (uart_tx(keypad->uart, keypad->tx_buf, SEND_BUF_SIZE, SYS_FOREVER_MS)) {
        return 1;
    }
    if (uart_rx_enable(keypad->uart, keypad->rx_buf, RECEIVE_BUF_SIZE, RECEIVE_TIMEOUT)) {
        return 1;
    }

    return 0;
}
```

## src/keypad.h
```c
#ifndef MY_KEYPAD_H_
#define MY_KEYPAD_H_

#include <stdint.h>
#include <zephyr/drivers/uart.h>
#include <zephyr/kernel.h>

#define RECEIVE_BUF_SIZE 16
#define RECEIVE_TIMEOUT 100
#define SEND_BUF_SIZE 64

struct my_keypad {
    struct device *uart;
    int id;
    int value;
    uint8_t tx_buf[SEND_BUF_SIZE];
    uint8_t rx_buf[RECEIVE_BUF_SIZE];
};

typedef struct my_keypad keypad;

int keypad_init(keypad *keypad);

#endif
```

## src/led.c
```c
#include "led.h"

#include <zephyr/device.h>
#include <zephyr/devicetree.h>
#include <zephyr/drivers/gpio.h>
#include <zephyr/sys/printk.h>

static struct gpio_dt_spec _leds[4] = {
    GPIO_DT_SPEC_GET(DT_ALIAS(led0), gpios),
    GPIO_DT_SPEC_GET(DT_ALIAS(led1), gpios),
    GPIO_DT_SPEC_GET(DT_ALIAS(led2), gpios),
    GPIO_DT_SPEC_GET(DT_ALIAS(led3), gpios)};

int invalid(led *led) {
    if (led == NULL) {
        return 1;
    }
    int id = led->id;
    if (id < 0 || id > 3) {
        return 1;
    }
    return 0;
}

int led_init(led *led) {
    int ret = invalid(led);
    if (ret) return ret;

    if (!device_is_ready((_leds[led->id].port))) {
        return 1;
    }

    ret = gpio_pin_configure_dt(&_leds[led->id], GPIO_OUTPUT_ACTIVE);
    if (ret < 0) {
        return 1;
    }
    return 0;
}

int led_toggle(led *led) {
    int ret = invalid(led);
    if (ret) return ret;

    return gpio_pin_toggle_dt(&_leds[led->id]);
}
```

## src/led.h
```c
#ifndef LEDS_H_
#define LEDS_H_



int led_init();

int led_toggle(int idx);

#endif
```

## src/timer.c
```c
#include <zephyr/kernel.h>
#include <zephyr/sys/printk.h>

#define STACKSIZE 1024

/* scheduling priority used by each thread */
#define PRIORITY 7

/* delay between greetings (in ms) */
#define SLEEPTIME 5000

K_THREAD_STACK_DEFINE(threadA_stack_area, STACKSIZE);
static struct k_thread threadA_data;

/* Defining a timer */
struct k_timer my_timer;
extern void my_expiry_function(struct k_timer *timer_id);

/* threadA is a static thread that is spawned automatically */

uint64_t start_time;

void threadA(void *dummy1, void *dummy2, void *dummy3) {
    ARG_UNUSED(dummy1);
    ARG_UNUSED(dummy2);
    ARG_UNUSED(dummy3);

    printk("thread_a: thread started \n");

    while (1) {
        // printk("thread_a: thread loop \n");
        k_msleep(SLEEPTIME);
    }
}

void my_expiry_function(struct k_timer *timer_id) {
    uint64_t start = start_time;
    int64_t delta = k_uptime_delta(&start);
    printk(">>>>> timer expired, elapsed time since start: %lld\n", delta);
}

void run_timer(void) {
    start_time = k_uptime_get();
    printk("run_timer start %lld\n", start_time);
    k_thread_create(&threadA_data, threadA_stack_area,
                    K_THREAD_STACK_SIZEOF(threadA_stack_area),
                    threadA, NULL, NULL, NULL,
                    PRIORITY, 0, K_FOREVER);

    k_thread_name_set(&threadA_data, "thread_a");

    k_timer_init(&my_timer, my_expiry_function, NULL);

    k_timer_start(&my_timer, K_MSEC(7000), K_MSEC(2000));

    k_thread_start(&threadA_data);
}
```

## src/util.c
```c
// #include <zephyr/sys/util.h>
#include <zephyr/kernel.h>

//    40  		/* STEP 9 - Submit the work item to the workqueue instead of calling emulate_work() directly */
//    41  		/* Remember to comment out emulate_work(); */
//    42          emulate_work();
//    43: 		delta_time = k_uptime_delta(&time_stamp);
//    44          printk("thread0 yielding this round in %lld ms\n", delta_time);

// int64_t get_seconds() {
//     return k_uptime_get();
// }
```
