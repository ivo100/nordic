## CMakeLists.txt
```
#
# Copyright (c) 
#
# SPDX-License-Identifier: LicenseRef-
#

cmake_minimum_required(VERSION 3.20.0)

find_package(Zephyr REQUIRED HINTS $ENV{ZEPHYR_BASE})

project("app")

# Include application event headers
zephyr_library_include_directories(src/events)

target_include_directories(app PRIVATE src/events)

# Application sources
target_sources(app PRIVATE src/main.c)

file(GLOB SRC_EVENTS "src/events/*.c")
target_sources(app PRIVATE ${SRC_EVENTS})

file(GLOB SRC_MODULES "src/modules/*.c")
target_sources(app PRIVATE ${SRC_MODULES})

#target_sources(app PRIVATE
#               src/events/ack_event.c
#               src/events/config_event.c
#               src/events/control_event.c
#               src/events/measurement_event.c
#)

#target_sources(app PRIVATE
#		src/modules/controller.c
#		src/modules/sensor_simulated.c
#		src/modules/stats.c
#)
```

## sample.yaml
```
sample:
  description: Sample showing Application Event Manager usage
  name: Application Event Manager sample
common:
  harness: console
  harness_config:
    ordered: false
    regex:
      - "config_event"
      - "measurement_event"
      - "control_event"
      - "ack_event"
      - "Average value3: 45"
    type: multi_line
tests:
  sample.app_event_manager:
    build_only: false
    integration_platforms:
      - nrf52840dk_nrf52840
  sample.app_event_manager_shell:
    build_only: false
    integration_platforms:
      - nrf52840dk_nrf52840
    extra_configs:
      - CONFIG_SHELL=y
```

## prj.conf
```kconfig
#
# Copyright (c) 2019 Nordic Semiconductor ASA
#
# SPDX-License-Identifier: LicenseRef-Nordic-5-Clause
#
# Enabling assert
CONFIG_ASSERT=y

# Logger configuration
CONFIG_LOG=y
CONFIG_LOG_DEFAULT_LEVEL=2
CONFIG_LOG_BACKEND_UART=y
#CONFIG_APP_LOG_LEVEL=4

# Configuration required by Application Event Manager
CONFIG_APP_EVENT_MANAGER=y
CONFIG_HEAP_MEM_POOL_SIZE=2048
CONFIG_REBOOT=y
```

## src/main.c
```c
/*
 * Copyright (c) 2019 Nordic Semiconductor ASA
 *
 * SPDX-License-Identifier: LicenseRef-Nordic-5-Clause
 */

#include <app_event_manager.h>
#include <config_event.h>
#include <zephyr/logging/log.h>

#define MODULE main

#define LOG_LEVEL 3
LOG_MODULE_REGISTER(MODULE, LOG_LEVEL);

#define INIT_VALUE1 3

void main(void) {
    char *version = "v1.0";

    for (int i = 0; i < 10; i++) {
        // printk("APP STARTS %s, i %d\n", version, i);
        // INF is level 4
        // LOG_INF("====INFO APP STARTS %s, i %d", version, i);
        LOG_WRN("====WARN APP STARTS %s, i %d", version, i);
        k_msleep(1000);
    }

    if (app_event_manager_init()) {
        LOG_ERR("Application Event Manager not initialized");
    } else {
        struct config_event *event = new_config_event();
        event->init_value1 = INIT_VALUE1;
        APP_EVENT_SUBMIT(event);
    }
}
```
